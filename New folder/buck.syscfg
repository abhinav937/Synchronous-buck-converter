/**
 * @cliArgs --board "/boards/LAUNCHXL_F28379D" --context "CPU1" --product "C2000WARE@5.01.00.00"
 * @versions {"tool":"1.19.0+3426"}
 */

/**
 * Import the modules used in this configuration.
 */
const led   = scripting.addModule("/driverlib/board_components/led", {}, false);
const led1  = led.addInstance();
const led2  = led.addInstance();
const epwm  = scripting.addModule("/driverlib/epwm.js", {}, false);
const epwm1 = epwm.addInstance();

/**
 * Write custom configuration values to the imported modules.
 */
led1.$name                  = "myBoardLED0";
led1.$hardware              = system.deviceData.board.components.LED4;
led1.gpio.writeInitialValue = true;

led2.$name                  = "myBoardLED1";
led2.$hardware              = system.deviceData.board.components.LED5;
led2.gpio.writeInitialValue = true;
led2.gpio.initialValue      = 1;

epwm1.$name                    = "myEPWM0";
epwm1.epwmTimebase_period      = 4000;
epwm1.epwmTimebase_counterMode = "EPWM_COUNTER_MODE_UP";

/**
 * Pinmux solution for unlocked pins/peripherals. This ensures that minor changes to the automatic solver in a future
 * version of the tool will not impact the pinmux you originally saw.  These lines can be completely deleted in order to
 * re-solve from scratch.
 */
led1.gpio.gpioPin.$suggestSolution    = "GPIO31";
led2.gpio.gpioPin.$suggestSolution    = "GPIO34";
epwm1.epwm.$suggestSolution           = "EPWM8";
epwm1.epwm.epwm_aPin.$suggestSolution = "boosterpack2.74";
epwm1.epwm.epwm_bPin.$suggestSolution = "boosterpack2.73";
